## app/boards/shields/KBD8X/Kconfig.defconfig
```kconfig
# Copyright (c) 2023 The ZMK Contributors
# SPDX-License-Identifier: MIT

if BOARD_KBD8X

config ZMK_KEYBOARD_NAME
    default "kbd8x"

endif # BOARD_KBD8X
```

## app/boards/shields/KBD8X/Kconfig.shield
```kconfig
# Copyright (c) 2024 The ZMK Contributors
# SPDX-License-Identifier: MIT

config SHIELD_KBD8X
  def_bool $(shields_list_contains,KBD8X)
```
